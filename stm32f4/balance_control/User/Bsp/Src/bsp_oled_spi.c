/**
 * @file    bsp_oled_spi.c
 * @brief   SSD1306 128×64 SPI DMA OLED 驱动实现
 *
 *  帧缓冲 framebuf[OLED_PAGES][OLED_WIDTH]（1 KB）
 *  Flush 时：先发 Page 地址命令，再 DMA 发送整列数据
 *  采用简化方式：整个 framebuf 展开为线性数组后单次 DMA 发送
 */
#include "bsp_oled_spi.h"
#include "spi.h"    /* hspi1 由 CubeMX 生成 */
#include "main.h"
#include <string.h>

/* -------------------------------------------------------------------------
 * SSD1306 初始化命令序列
 * ---------------------------------------------------------------------- */
static const uint8_t k_oled_init_cmds[] =
{
    0xAEU,          /* Display OFF */
    0x20U, 0x00U,   /* Memory Addressing Mode: Horizontal */
    0xB0U,          /* Page Start Address = 0 */
    0xC8U,          /* COM Output Scan Direction (remapped) */
    0x00U,          /* Column Low Start: 0 */
    0x10U,          /* Column High Start: 0 */
    0x40U,          /* Display Start Line: 0 */
    0x81U, 0xFFU,   /* Contrast: Max */
    0xA1U,          /* Segment Re-map */
    0xA6U,          /* Normal Display (not inverted) */
    0xA8U, 0x3FU,   /* Multiplex Ratio: 64 */
    0xA4U,          /* Output follows RAM */
    0xD3U, 0x00U,   /* Display Offset: 0 */
    0xD5U, 0xF0U,   /* Display Clock Divide: 15/1 */
    0xD9U, 0x22U,   /* Pre-charge Period */
    0xDAU, 0x12U,   /* COM Pins Hardware Config */
    0xDBU, 0x20U,   /* VCOMH Deselect Level */
    0x8DU, 0x14U,   /* Charge Pump: Enable */
    0xAFU,          /* Display ON */
    /* ------------------------------------------------------------------
     * 全屏地址范围：Horizontal Addressing Mode 下只需设置一次。
     * Flush 时 DMA 写满 1024 B 后地址自动回绕，无需每帧重置。
     * 将此移到 Init 以消除 BSP_OledSpi_Flush() 内的 6 次阻塞 SPI 调用。
     * ------------------------------------------------------------------ */
    0x21U, 0x00U, 0x7FU,   /* Column Address: 0–127 */
    0x22U, 0x00U, 0x07U,   /* Page Address:   0–7   */
};

/* 5×7 ASCII 字体（仅包含可见 ASCII 0x20–0x7E） */
static const uint8_t k_font5x7[][5U] =
{
    {0x00,0x00,0x00,0x00,0x00}, /* 0x20 space */
    {0x00,0x00,0x5F,0x00,0x00}, /* 0x21 ! */
    {0x00,0x07,0x00,0x07,0x00}, /* 0x22 " */
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    {0x32,0x49,0x79,0x41,0x3E}, /* 0x40 @ */
    /* A–Z */
    {0x7E,0x11,0x11,0x11,0x7E}, /* A */
    {0x7F,0x49,0x49,0x49,0x36}, /* B */
    {0x3E,0x41,0x41,0x41,0x22}, /* C */
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    {0x61,0x51,0x49,0x45,0x43}, /* Z */
    /* a-z（简化，使用相同字形） */
    {0x20,0x54,0x54,0x54,0x78}, /* a */
    {0x7F,0x48,0x44,0x44,0x38}, /* b */
    {0x38,0x44,0x44,0x44,0x20}, /* c */
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    {0x08,0x08,0x2A,0x1C,0x08}, /* ~ */
};

/* -------------------------------------------------------------------------
 * 私有状态
 * ---------------------------------------------------------------------- */
/* 帧缓冲：线性排列 page0_col0..127, page1_col0..127 ... */
static uint8_t s_framebuf[OLED_PAGES * OLED_WIDTH];
static volatile bool s_dma_busy = false;

/* -------------------------------------------------------------------------
 * 私有：发送单个命令字节
 * ---------------------------------------------------------------------- */
static void oled_send_cmd(uint8_t cmd)
{
    HAL_GPIO_WritePin(OLED_SPI_CS_GPIO_Port, OLED_SPI_CS_Pin, GPIO_PIN_RESET);
    HAL_GPIO_WritePin(OLED_DC_GPIO_Port,     OLED_DC_Pin,     GPIO_PIN_RESET); /* 命令 */
    (void)HAL_SPI_Transmit(&hspi1, &cmd, 1U, 10U);
    HAL_GPIO_WritePin(OLED_SPI_CS_GPIO_Port, OLED_SPI_CS_Pin, GPIO_PIN_SET);
}

/* -------------------------------------------------------------------------
 * 公开接口实现
 * ---------------------------------------------------------------------- */

void BSP_OledSpi_Init(void)
{
    /* RST 时序 */
    HAL_GPIO_WritePin(OLED_RST_GPIO_Port, OLED_RST_Pin, GPIO_PIN_RESET);
    HAL_Delay(10U);
    HAL_GPIO_WritePin(OLED_RST_GPIO_Port, OLED_RST_Pin, GPIO_PIN_SET);
    HAL_Delay(10U);

    /* 发送初始化命令序列 */
    uint8_t i;
    for (i = 0U; i < (uint8_t)sizeof(k_oled_init_cmds); i++)
    {
        oled_send_cmd(k_oled_init_cmds[i]);
    }

    BSP_OledSpi_Clear();
}

void BSP_OledSpi_DrawPixel(uint8_t x, uint8_t y, uint8_t pixel)
{
    if (x >= OLED_WIDTH || y >= OLED_HEIGHT)
    {
        return;
    }
    uint8_t page   = y / 8U;
    uint8_t bit    = y % 8U;
    uint16_t index = (uint16_t)(page * OLED_WIDTH + x);

    if (pixel)
    {
        s_framebuf[index] |= (uint8_t)(1U << bit);
    }
    else
    {
        s_framebuf[index] &= (uint8_t)(~(1U << bit));
    }
}

void BSP_OledSpi_DrawChar(uint8_t x, uint8_t page, char ch)
{
    if ((uint8_t)ch < 0x20U || (uint8_t)ch > 0x7EU)
    {
        return;
    }
    uint8_t idx = (uint8_t)((uint8_t)ch - 0x20U);
    uint8_t col;
    for (col = 0U; col < 5U; col++)
    {
        if ((x + col) < OLED_WIDTH && page < OLED_PAGES)
        {
            s_framebuf[(uint16_t)(page * OLED_WIDTH + x + col)] = k_font5x7[idx][col];
        }
    }
}

void BSP_OledSpi_DrawString(uint8_t x, uint8_t page, const char *str)
{
    if (str == NULL)
    {
        return;
    }
    while (*str != '\0' && x < OLED_WIDTH)
    {
        BSP_OledSpi_DrawChar(x, page, *str);
        str++;
        x = (uint8_t)(x + 6U); /* 5 像素字符 + 1 像素间距 */
    }
}

void BSP_OledSpi_Clear(void)
{
    (void)memset(s_framebuf, 0, sizeof(s_framebuf));
}

bsp_err_t BSP_OledSpi_Flush(void)
{
    if (s_dma_busy)
    {
        return BSP_ERR_BUSY;
    }

    /* Column/Page 地址范围已在 Init 固定为全屏，此处直接启动 DMA 数据传输。
     * 消除原有 6 次阻塞 SPI 命令调用，Flush 全程非阻塞。 */

    /* DMA 发送帧缓冲（数据模式） */
    HAL_GPIO_WritePin(OLED_SPI_CS_GPIO_Port, OLED_SPI_CS_Pin, GPIO_PIN_RESET);
    HAL_GPIO_WritePin(OLED_DC_GPIO_Port,     OLED_DC_Pin,     GPIO_PIN_SET); /* 数据 */

    s_dma_busy = true;
    if (HAL_SPI_Transmit_DMA(&hspi1, s_framebuf, (uint16_t)sizeof(s_framebuf)) != HAL_OK)
    {
        s_dma_busy = false;
        HAL_GPIO_WritePin(OLED_SPI_CS_GPIO_Port, OLED_SPI_CS_Pin, GPIO_PIN_SET);
        return BSP_ERR_BUSY;
    }

    return BSP_OK;
}

/* -------------------------------------------------------------------------
 * 私有：释放 SPI 总线（成功与错误路径共用）
 * ---------------------------------------------------------------------- */
static void release_bus(void)
{
    HAL_GPIO_WritePin(OLED_SPI_CS_GPIO_Port, OLED_SPI_CS_Pin, GPIO_PIN_SET);
    s_dma_busy = false;
}

void BSP_OledSpi_TxCpltCallback(void)
{
    release_bus();
    /* 传输成功：SSD1306 内部地址指针已回绕至 (0,0)，无需额外操作。 */
}

/* HAL 回调转发 */
void HAL_SPI_TxCpltCallback(SPI_HandleTypeDef *hspi)
{
    if (hspi->Instance == SPI1)
    {
        BSP_OledSpi_TxCpltCallback();
    }
}

/**
 * @brief SPI DMA 错误恢复（覆盖 HAL weak 符号）
 *
 *  修复前：每帧 Flush 都重发地址命令，DMA 出错后下帧自动恢复位置。
 *  修复后：地址命令移至 Init，DMA 中途出错时 SSD1306 地址指针停在中间，
 *           需在此处主动重发全屏地址命令，否则下次 Flush 数据从错误位置写入。
 */
void HAL_SPI_ErrorCallback(SPI_HandleTypeDef *hspi)
{
    if (hspi->Instance == SPI1)
    {
        release_bus();
        /* 重置 SSD1306 地址指针至全屏起点，恢复 Horizontal Addressing Mode 状态。 */
        oled_send_cmd(0x21U); oled_send_cmd(0x00U); oled_send_cmd(0x7FU); /* Column 0-127 */
        oled_send_cmd(0x22U); oled_send_cmd(0x00U); oled_send_cmd(0x07U); /* Page   0-7   */
    }
}
